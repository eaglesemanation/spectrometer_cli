## sbc_config/buildroot-external/package/spectrometer_sbc/Config.in
```kconfig
config BR2_PACKAGE_SPECTROMETER_SBC
	bool "spectrometer_sbc"
	depends on BR2_PACKAGE_HOST_RUSTC_TARGET_ARCH_SUPPORTS
    select BR2_PACKAGE_HOST_WASM_PACK
	select BR2_PACKAGE_HOST_RUSTC
    select BR2_PACKAGE_EUDEV
	help
	  CCD LCAM V06 board client used as a spectrometer

	  https://github.com/eaglesemanation/spectrometer_utils

if BR2_PACKAGE_SPECTROMETER_SBC

config BR2_PACKAGE_SPECTROMETER_SBC_LASER_PIN
	int "GPIO laser pin"

config BR2_PACKAGE_SPECTROMETER_SBC_BUTTON_PIN
	int "GPIO button pin"

endif
```

## sbc_config/package/spectrometer_sbc/Config.in
```kconfig
config BR2_PACKAGE_SPECTROMETER_SBC
	bool "spectrometer_sbc"
	depends on BR2_PACKAGE_HOST_RUSTC_TARGET_ARCH_SUPPORTS
	select BR2_PACKAGE_HOST_RUSTC
	help
	  CCD LCAM V06 board client used as a spectrometer

	  https://github.com/eaglesemanation/spectrometer_utils

if BR2_PACKAGE_SPECTROMETER_SBC

config BR2_PACKAGE_SPECTROMETER_SBC_LASER_PIN
	int "GPIO laser pin"
	default "23"

config BR2_PACKAGE_SPECTROMETER_SBC_BUTTON_PIN
	int "GPIO button pin"
	default "21"

endif
```
